## CMakeLists.txt
```
# SPDX-License-Identifier: GPL-2.0-only
cmake_minimum_required(VERSION 3.20.0)
find_package(Zephyr REQUIRED HINTS $ENV{ZEPHYR_BASE})
project(mlink_modem)

# The ring code is the Linux driver's, built verbatim (D19).
set(MLINK_DRIVER ${CMAKE_CURRENT_SOURCE_DIR}/../../driver)
target_sources(app PRIVATE src/main.c src/ctrl.c ${MLINK_DRIVER}/mlink_ring.c)
target_sources_ifdef(CONFIG_MLINK_MODEM_NET app PRIVATE src/net.c)
# tools/: mlink_ctrl_lib.h, the TLV helpers mlinkd uses
target_include_directories(app PRIVATE compat ${MLINK_DRIVER} ${CMAKE_CURRENT_SOURCE_DIR}/../../tools)
# Kernel C does arithmetic on void * (a GNU extension Kbuild allows).
set_source_files_properties(${MLINK_DRIVER}/mlink_ring.c PROPERTIES COMPILE_OPTIONS -Wno-pointer-arith)
```

## Kconfig
```
# SPDX-License-Identifier: GPL-2.0-only
mainmenu "mlink Zephyr modem"

config MLINK_MODEM_NET
	bool "Hand packets to the Zephyr IP stack instead of reflecting them"
	depends on NETWORKING && NET_L2_DUMMY
	help
	  P8.3: register the mlink ring pair as a raw-IP (DUMMY_L2) network
	  interface at 10.77.0.2/24 and run UDP echo :7, TCP echo :7 and TCP
	  discard :9 on it. Without it the modem runs in loopback test mode.

source "Kconfig.zephyr"
```

## prj.conf
```kconfig
CONFIG_PRINTK=y
CONFIG_POLL=y
CONFIG_MAIN_STACK_SIZE=4096

CONFIG_PCIE=y
CONFIG_PCIE_MSI=y
CONFIG_PCIE_MSI_X=y
CONFIG_PCIE_MSI_MULTI_VECTOR=y

CONFIG_VIRTUALIZATION=y
CONFIG_IVSHMEM=y
CONFIG_IVSHMEM_DOORBELL=y
# DATA, SPACE, STATE, TEST, CTRL (mlink_shm.h)
CONFIG_IVSHMEM_MSI_X_VECTORS=5

# room to map the 4 MiB BAR2 next to the image
CONFIG_KERNEL_VM_SIZE=0x2000000
```

## net.conf
```kconfig
# P8.3 IP-stack mode: west build ... -- -DEXTRA_CONF_FILE=net.conf
CONFIG_MLINK_MODEM_NET=y

CONFIG_NETWORKING=y
CONFIG_NET_L2_DUMMY=y
CONFIG_NET_LOOPBACK=n
CONFIG_NET_IPV4=y
CONFIG_NET_IPV6=n
CONFIG_NET_UDP=y
CONFIG_NET_TCP=y
CONFIG_NET_SOCKETS=y
CONFIG_NET_MAX_CONTEXTS=8

# On QEMU targets NETWORKING=y defaults to SLIP over a UART pipe (it takes over
# the console UART) plus e1000. NET_SLIP_TAP is what selects SLIP/UART_PIPE;
# with no network drivers built, mlink0 is the only interface here.
CONFIG_NET_SLIP_TAP=n
CONFIG_NET_DRIVERS=n

# room for a TCP window's worth of 1500-byte packets in each direction
CONFIG_NET_PKT_RX_COUNT=64
CONFIG_NET_PKT_TX_COUNT=64
CONFIG_NET_BUF_RX_COUNT=512
CONFIG_NET_BUF_TX_COUNT=512
```

## app.overlay
```dts
/*
 * ivshmem PCI device node, as in Zephyr's
 * samples/drivers/virtualization/ivshmem/doorbell/boards/pcie_ivshmem.dtsi
 * (Copyright (c) 2023 Huawei France Technologies SASU, Apache-2.0).
 */
#include <zephyr/dt-bindings/pcie/pcie.h>

/ {
	ivhsmem {
		ivshmem0: ivshmem {
			compatible = "qemu,ivshmem";

			vendor-id = <0x1af4>;
			device-id = <0x1110>;
			status = "okay";
		};
	};
};
```

## src/main.c
```c
// SPDX-License-Identifier: GPL-2.0-only
/*
 * mlink modem on Zephyr (P8.2/P8.3, plan.md D19/D20).
 *
 * Takes the modem role of the shared-memory ABI in driver/mlink_shm.h, using
 * the Linux driver's ring code (driver/mlink_ring.c) unchanged. The link state
 * machine mirrors driver/mlink_link.c. The data path either reflects every
 * IPv4 ICMP echo request as a reply and every UDP datagram back to its sender
 * (loopback test mode, default), or with CONFIG_MLINK_MODEM_NET hands packets
 * to the Zephyr IP stack (net.c).
 *
 * One thread runs the link and RX: it sleeps on the five doorbell vectors
 * with a HB_MS timeout, so a kick wakes it at once and the timeout drives the
 * heartbeat and handshake.
 */
#include <string.h>

#include <zephyr/drivers/virtualization/ivshmem.h>
#include <zephyr/sys/byteorder.h>
#include <zephyr/sys/printk.h>

#include "modem.h"

#define HB_MS		50
#define HB_TIMEOUT_MS	500	/* same as the driver's hb_timeout_ms default */
#define RX_BUDGET	64
#define STATS_MS	5000

enum reset_reason { R_HB_TIMEOUT, R_PEER_GEN, R_PEER_DOWN, R_RING };

static const char *const reset_names[] = {
	[R_HB_TIMEOUT] = "heartbeat timeout",
	[R_PEER_GEN]   = "peer restarted (gen changed)",
	[R_PEER_DOWN]  = "peer went down",
	[R_RING]       = "ring error",
};

struct modem m;

static struct k_poll_signal sigs[MLINK_NR_VECTORS];
static struct k_poll_event events[MLINK_NR_VECTORS];
static u8 pkt[MLINK_SLOT_SIZE];	/* private copy: never parse shared memory in place */

void modem_kick(enum mlink_vector vec)
{
	if (vec == MLINK_VEC_DATA)
		m.st.kicks_data++;
	else if (vec == MLINK_VEC_SPACE)
		m.st.kicks_space++;
	else if (vec == MLINK_VEC_STATE)
		m.st.kicks_state++;
	ivshmem_int_peer(m.dev, m.peer_id, vec);
}

/* ---- shared header (AP-owned, validated like mlink_hdr_valid()) ---------- */

/* crc32_le(~0, ...) as the Linux driver computes it: reflected, no final xor. */
static u32 crc32_le_noxor(u32 crc, const u8 *p, size_t len)
{
	while (len--) {
		crc ^= *p++;
		for (int i = 0; i < 8; i++)
			crc = (crc >> 1) ^ (0xedb88320 & -(crc & 1));
	}
	return crc;
}

static bool hdr_valid(void)
{
	struct mlink_shm_hdr *sh = m.hdr;
	struct mlink_shm_hdr want = {
		.abi_version = MLINK_ABI_VERSION,
		.ring_entries = MLINK_RING_ENTRIES,
		.slot_size = MLINK_SLOT_SIZE,
		.ring_a_off = MLINK_RING_A_OFF,
		.ring_b_off = MLINK_RING_B_OFF,
	};

	want.layout_crc = crc32_le_noxor(~0u, (u8 *)&want + MLINK_HDR_CRC_START,
					 MLINK_HDR_CRC_LEN);
	/* Pairs with the AP's release of magic: the fields below are complete. */
	if (virt_load_acquire(&sh->magic) != MLINK_SHM_MAGIC)
		return false;
	return READ_ONCE(sh->abi_version) == want.abi_version &&
	       READ_ONCE(sh->ring_entries) == want.ring_entries &&
	       READ_ONCE(sh->slot_size) == want.slot_size &&
	       READ_ONCE(sh->ring_a_off) == want.ring_a_off &&
	       READ_ONCE(sh->ring_b_off) == want.ring_b_off &&
	       READ_ONCE(sh->layout_crc) == want.layout_crc;
}

/* ---- link state machine (mirrors driver/mlink_link.c) -------------------- */

static void state_publish(enum mlink_link_state st)
{
	struct mlink_shm_state *s = m.self;

	WRITE_ONCE(s->peer_id, m.own_id);
	WRITE_ONCE(s->mtu, OWN_MTU);
	WRITE_ONCE(s->state, st);
	/* Release: the fields above are visible before (or with) the magic. */
	virt_store_release(&s->magic, MLINK_STATE_MAGIC);
	m.state = st;
}

static void link_new_gen(void)
{
	struct mlink_shm_state *s = m.self;

	/* gen survives in shm across our restarts, so the AP always sees a change. */
	WRITE_ONCE(s->gen, READ_ONCE(s->gen) + 1);
	m.gen = READ_ONCE(s->gen);
	virt_wmb();	/* new gen visible before the zeroed indices */
	/* No producer may be mid-publish while its index is zeroed. */
	k_mutex_lock(&m.tx_lock, K_FOREVER);
	mlink_ring_reset_producer(&m.tx);
	m.tx_seq = 0;
	m.tx_broken = false;
	k_mutex_unlock(&m.tx_lock);
	mlink_ring_reset_consumer(&m.rx);
	/* Stale control indices from an earlier Linux modem would look like corruption. */
	mlink_ring_reset_producer(&m.ctrl_tx);
	mlink_ring_reset_consumer(&m.ctrl_rx);
	m.rx_broken = false;
}

static void link_start(void)
{
	link_new_gen();
	m.hb_seen = READ_ONCE(m.peer->heartbeat);
	m.hb_changed = k_uptime_get();
	state_publish(MLINK_ST_WAIT_PEER);
}

static void link_reset(enum reset_reason why)
{
	printk("mlink-modem: link reset: %s (was %s)\n", reset_names[why],
	       m.state == MLINK_ST_UP ? "UP" : "WAIT_PEER");
	m.st.link_resets++;
	/* Senders check link_up under tx_lock; RX runs in this thread. */
	WRITE_ONCE(m.link_up, false);
	modem_net_carrier(false);
	k_sem_give(&m.space_sem);	/* a sender waiting for space rechecks link_up */
	link_new_gen();
	state_publish(MLINK_ST_WAIT_PEER);
	if (m.peer_found)
		modem_kick(MLINK_VEC_STATE);
}

static void link_bring_up(void)
{
	m.st.link_ups++;
	state_publish(MLINK_ST_UP);
	WRITE_ONCE(m.link_up, true);
	modem_net_carrier(m.data_call);
	modem_kick(MLINK_VEC_STATE);
	printk("mlink-modem: link UP: peer id=%u gen=%u, own gen=%u\n",
	       m.peer_id, m.peer_gen, m.gen);
}

static void link_tick(void)
{
	struct mlink_shm_state *p = m.peer;
	u32 magic, pid, pstate, pgen, pseen, phb;
	bool valid, alive;
	int64_t now = k_uptime_get();

	if (!m.hdr_ok) {
		/* The AP owns the layout; wait until it has published it. */
		if (!hdr_valid())
			return;
		m.hdr_ok = true;
		printk("mlink-modem: shared header valid (abi %u)\n", MLINK_ABI_VERSION);
		link_start();
	}

	WRITE_ONCE(m.self->heartbeat, READ_ONCE(m.self->heartbeat) + 1);

	/* Snapshot the peer block once (untrusted): magic first, with acquire. */
	magic = virt_load_acquire(&p->magic);
	pid = READ_ONCE(p->peer_id);
	pseen = READ_ONCE(p->peer_gen_seen);
	virt_rmb();	/* pairs with the AP's wmb: its ack is never newer than its gen */
	pgen = READ_ONCE(p->gen);
	pstate = READ_ONCE(p->state);
	phb = READ_ONCE(p->heartbeat);

	if (phb != m.hb_seen) {
		m.hb_seen = phb;
		m.hb_changed = now;
	} else if (m.state == MLINK_ST_UP) {
		/* Ring progress by the AP is proof of life too (heartbeat starvation). */
		u32 act = READ_ONCE(m.rx.ctrl->prod.val) ^ (READ_ONCE(m.tx.ctrl->cons.val) << 1);

		if (act != m.peer_activity) {
			m.peer_activity = act;
			m.hb_changed = now;
		}
	}
	alive = now - m.hb_changed < HB_TIMEOUT_MS;
	valid = magic == MLINK_STATE_MAGIC && pid <= UINT16_MAX && pid != m.own_id;

	if (valid && (!m.peer_found || pid != m.peer_id)) {
		m.peer_id = pid;
		m.peer_found = true;
		printk("mlink-modem: peer found: id=%u gen=%u\n", pid, pgen);
	} else if (!valid && m.peer_found) {
		m.peer_found = false;
		printk("mlink-modem: peer gone\n");
	}

	if (m.state == MLINK_ST_UP) {
		if (!valid || (pstate != MLINK_ST_UP && pstate != MLINK_ST_WAIT_PEER))
			link_reset(R_PEER_DOWN);
		else if (pgen != m.peer_gen)
			link_reset(R_PEER_GEN);
		else if (!alive)
			link_reset(R_HB_TIMEOUT);
		else if (m.rx_broken || m.tx_broken)
			link_reset(R_RING);
		return;
	}

	/* WAIT_PEER: acknowledge the AP's current generation... */
	if (valid && alive && (pstate == MLINK_ST_WAIT_PEER || pstate == MLINK_ST_UP)) {
		if (READ_ONCE(m.self->peer_gen_seen) != pgen) {
			m.peer_gen = pgen;
			virt_wmb();	/* our gen/reset are already published; the ack comes after */
			WRITE_ONCE(m.self->peer_gen_seen, pgen);
			modem_kick(MLINK_VEC_STATE);
		}
		/* ...and go UP once it has acknowledged ours. */
		if (pseen == m.gen && m.peer_gen == pgen)
			link_bring_up();
	}
}

/* ---- loopback ------------------------------------------------------------ */

/* RFC 1624 eqn. 3: update a 16-bit one's complement checksum for old -> new. */
static void csum_replace16(u8 *csum, u16 old, u16 new)
{
	u32 s = (u16)~sys_get_be16(csum) + (u16)~old + new;

	s = (s & 0xffff) + (s >> 16);
	s = (s & 0xffff) + (s >> 16);
	sys_put_be16((u16)~s, csum);
}

static void swap_bytes(u8 *a, u8 *b, size_t n)
{
	u8 t[4];

	memcpy(t, a, n);
	memcpy(a, b, n);
	memcpy(b, t, n);
}

/*
 * Turn the packet in pkt[] into its reply in place. Swapping two 16-bit-aligned
 * fields never changes a one's complement sum, so the IP header checksum, the
 * UDP checksum and a CHECKSUM_PARTIAL pseudo-header seed all stay valid.
 * Returns false to drop.
 */
static bool reflect(u32 len, const struct mlink_rx_desc *d)
{
	u32 ihl, tot;
	u8 *l4;

	if (d->proto != MLINK_PROTO_IPV4 || len < 20 || (pkt[0] >> 4) != 4)
		return false;
	ihl = (pkt[0] & 0xf) * 4;
	tot = sys_get_be16(&pkt[2]);
	if (ihl < 20 || tot < ihl || tot > len)
		return false;
	l4 = &pkt[ihl];

	/*
	 * A non-first fragment carries no L4 header: swapping the addresses is
	 * all it needs. The first fragment's L4 checksum covers the whole
	 * datagram, and the incremental update below stays correct for it.
	 */
	if (sys_get_be16(&pkt[6]) & 0x1fff) {
		if (pkt[9] != 1 && pkt[9] != 17)
			return false;
		m.st.frags++;
		goto swap_addr;
	}
	if (tot < ihl + 8)
		return false;

	switch (pkt[9]) {
	case 1:		/* ICMP */
		/* The stack fills ICMP checksums itself; partial would be a bug. */
		if (l4[0] != 8 || l4[1] != 0 || (d->flags & MLINK_DESC_F_CSUM_PARTIAL))
			return false;
		l4[0] = 0;	/* echo request -> echo reply */
		csum_replace16(&l4[2], 0x0800, 0x0000);
		m.st.icmp++;
		break;
	case 17:	/* UDP */
		swap_bytes(&l4[0], &l4[2], 2);
		m.st.udp++;
		break;
	default:
		return false;
	}
swap_addr:
	swap_bytes(&pkt[12], &pkt[16], 4);
	return true;
}

/* ---- data path (the modem-side counterpart of mlink_poll()) -------------- */

/* Returns true if it stopped on the budget and should run again right away. */
static bool data_poll(void)
{
	struct mlink_rx_desc d;
	bool consumed = false, published = false;
	int n, budget = RX_BUDGET;

	mlink_ring_disarm_kick(&m.rx);	/* we are polling: no DATA kicks needed */
	while (budget) {
		n = mlink_ring_peek(&m.rx, &d);
		if (n == 0) {
			/* Going idle: arm the kick, then re-check (SB pattern). */
			if (!mlink_ring_arm_kick(&m.rx, true))
				break;
			mlink_ring_disarm_kick(&m.rx);
			continue;
		}
		if (n == -EIO) {
			m.rx_broken = true;
			break;
		}
		if (n == -EMSGSIZE) {
			m.st.bad_len++;
			goto consume;
		}
		if (!READ_ONCE(m.data_call)) {
			/* "Data call" down (SET_DATA_CALL from the AP): no data service. */
			m.st.dc_dropped++;
			goto consume;
		}
		m.st.rx_bytes += d.len;

		if (IS_ENABLED(CONFIG_MLINK_MODEM_NET)) {
			m.st.rx++;
			memcpy(pkt, d.data, d.len);	/* single fetch of the payload */
			if (modem_net_rx(pkt, d.len, &d))
				m.st.to_stack++;
			else
				m.st.dropped++;
			goto consume;
		}

		/*
		 * Loopback: this thread is ring B's only producer, and the reset
		 * runs in this thread too, so no tx_lock is needed here.
		 */
		n = mlink_ring_free(&m.tx);
		if (n < 0) {
			m.tx_broken = true;
			break;
		}
		if (n == 0) {
			/* Ring B full: leave this packet in ring A until the AP frees a slot. */
			if (!mlink_ring_arm_space(&m.tx, true)) {
				m.st.tx_full++;
				break;
			}
			mlink_ring_disarm_space(&m.tx);
		}

		m.st.rx++;
		memcpy(pkt, d.data, d.len);	/* single fetch of the payload */
		if (reflect(d.len, &d)) {
			struct mlink_tx_meta meta = {
				.proto = d.proto,
				.flags = d.flags & MLINK_DESC_F_CSUM_PARTIAL,
				.csum_start = d.csum_start,
				.csum_offset = d.csum_offset,
			};

			memcpy(mlink_ring_slot(&m.tx), pkt, d.len);
			mlink_ring_publish(&m.tx, d.len, &meta, m.tx_seq++);
			published = true;
			m.st.tx++;
			m.st.tx_bytes += d.len;
		} else {
			m.st.dropped++;
		}
consume:
		mlink_ring_consume(&m.rx);
		consumed = true;
		budget--;
	}

	if (consumed) {
		mlink_ring_release(&m.rx);
		if (mlink_ring_need_space_kick(&m.rx, true))
			modem_kick(MLINK_VEC_SPACE);
	}
	if (published && mlink_ring_need_kick(&m.tx, true))
		modem_kick(MLINK_VEC_DATA);
	return budget == 0;
}

/* ---- main ---------------------------------------------------------------- */

static void print_stats(void)
{
	struct modem_stats *s = &m.st;

	printk("mlink-modem: %s gen=%u rx=%u tx=%u icmp=%u udp=%u frag=%u stack=%u csum=%u "
	       "drop=%u badlen=%u full=%u txwait=%u txdrop=%u irq=%u/%u/%u/%u/%u "
	       "kicks d/s/st=%u/%u/%u ups=%u resets=%u ctrl req/resp/inv/full=%u/%u/%u/%u "
	       "dcdrop=%u\n",
	       m.state == MLINK_ST_UP ? "UP" : "WAIT", m.gen, s->rx, s->tx, s->icmp, s->udp,
	       s->frags, s->to_stack, s->csum_fixed, s->dropped, s->bad_len, s->tx_full,
	       s->tx_waits, s->tx_dropped, s->irqs[0], s->irqs[1], s->irqs[2],
	       s->irqs[3], s->irqs[4], s->kicks_data, s->kicks_space, s->kicks_state,
	       s->link_ups, s->link_resets, s->ctrl_req, s->ctrl_resp, s->ctrl_invalid,
	       s->ctrl_full, s->dc_dropped);
}

int main(void)
{
	uintptr_t base;
	size_t size;
	int64_t next_hb, next_stats;
	struct modem_stats last = {0};
	bool busy = false;

	k_mutex_init(&m.tx_lock);
	k_sem_init(&m.space_sem, 0, 1);
	m.data_call = true;
	m.dev = DEVICE_DT_GET(DT_NODELABEL(ivshmem0));
	if (!device_is_ready(m.dev)) {
		printk("mlink-modem: no ivshmem device\n");
		return 0;
	}
	size = ivshmem_get_mem(m.dev, &base);
	if (size < MLINK_LAYOUT_END ||
	    ivshmem_get_vectors(m.dev) < MLINK_NR_VECTORS) {
		printk("mlink-modem: need %u bytes / %u vectors, have %zu / %u\n",
		       MLINK_LAYOUT_END, MLINK_NR_VECTORS, size, ivshmem_get_vectors(m.dev));
		return 0;
	}
	m.shm = (u8 *)base;
	m.hdr = (struct mlink_shm_hdr *)(m.shm + MLINK_HDR_OFF);
	m.self = (struct mlink_shm_state *)(m.shm + MLINK_STATE_MODEM_OFF);
	m.peer = (struct mlink_shm_state *)(m.shm + MLINK_STATE_AP_OFF);
	m.own_id = ivshmem_get_id(m.dev);
	mlink_ring_attach(&m.tx, m.shm + MLINK_RING_B_OFF, MLINK_RING_ENTRIES, MLINK_SLOT_SIZE);
	mlink_ring_attach(&m.rx, m.shm + MLINK_RING_A_OFF, MLINK_RING_ENTRIES, MLINK_SLOT_SIZE);
	mlink_ring_attach(&m.ctrl_tx, m.shm + MLINK_CTRL_D_OFF, MLINK_CTRL_ENTRIES,
			  MLINK_CTRL_SLOT_SIZE);
	mlink_ring_attach(&m.ctrl_rx, m.shm + MLINK_CTRL_C_OFF, MLINK_CTRL_ENTRIES,
			  MLINK_CTRL_SLOT_SIZE);

	for (int i = 0; i < MLINK_NR_VECTORS; i++) {
		k_poll_signal_init(&sigs[i]);
		k_poll_event_init(&events[i], K_POLL_TYPE_SIGNAL, K_POLL_MODE_NOTIFY_ONLY,
				  &sigs[i]);
		ivshmem_register_handler(m.dev, &sigs[i], i);
	}
	printk("mlink-modem: role=modem own_id=%u shm=%zu bytes abi=%u\n",
	       m.own_id, size, MLINK_ABI_VERSION);

	next_hb = next_stats = k_uptime_get();
	for (;;) {
		int64_t now = k_uptime_get();

		k_poll(events, MLINK_NR_VECTORS,
		       busy ? K_NO_WAIT : K_MSEC(MAX(next_hb - now, 0)));
		for (int i = 0; i < MLINK_NR_VECTORS; i++) {
			if (events[i].state == K_POLL_STATE_SIGNALED) {
				m.st.irqs[i]++;
				k_poll_signal_reset(&sigs[i]);
				events[i].state = K_POLL_STATE_NOT_READY;
				/* A sender blocked on a full ring B (IP-stack mode) may go on. */
				if (i == MLINK_VEC_SPACE)
					k_sem_give(&m.space_sem);
			}
		}

		now = k_uptime_get();
		if (now >= next_hb) {
			link_tick();
			next_hb = now + HB_MS;
		}
		/* Any wakeup (DATA, SPACE, STATE, CTRL or timeout) may have work for us. */
		busy = m.link_up && data_poll();
		if (m.link_up)
			modem_ctrl_poll();

		if (now >= next_stats) {
			if (memcmp(&last, &m.st, sizeof(last))) {
				print_stats();
				last = m.st;
			}
			next_stats = now + STATS_MS;
		}
	}
	return 0;
}
```

## src/ctrl.c
```c
// SPDX-License-Identifier: GPL-2.0-only
/*
 * Control plane on the Zephyr modem: what tools/mlinkd does on the Linux
 * modem, but straight on control rings C (requests in) and D (responses and
 * indications out), with no /dev/mlink_ctrl in between. Same message format
 * (driver/mlink_ctrl.h) and the same TLV helpers (tools/mlink_ctrl_lib.h).
 *
 * Framing as in driver/mlink_ctrl.c: one message per slot, proto
 * MLINK_PROTO_CTRL, desc seq = txn_id; the control rings use no kick
 * suppression, every publish or consume rings the CTRL vector.
 * Runs in the poll thread, which is the only producer of ring D.
 */
#include <zephyr/kernel.h>
#include <zephyr/sys/printk.h>

#include "modem.h"
#include "mlink_ctrl_lib.h"

static struct msgbuf req, resp;	/* poll thread only */

/* Queue one message on ring D; false (and counted) if the ring is full. */
static bool ctrl_send(const struct msgbuf *msg)
{
	const struct mlink_tx_meta meta = { .proto = MLINK_PROTO_CTRL };
	int n = mlink_ring_free(&m.ctrl_tx);

	if (n < 0) {
		m.tx_broken = true;	/* the link tick resets */
		return false;
	}
	if (n == 0) {
		/* Low rate, AP drains on every CTRL kick: drop instead of blocking. */
		m.st.ctrl_full++;
		return false;
	}
	memcpy(mlink_ring_slot(&m.ctrl_tx), msg->raw, msg_size(msg));
	mlink_ring_publish(&m.ctrl_tx, msg_size(msg), &meta, msg->h.txn_id);
	return true;
}

static bool serve(size_t len)
{
	bool sent;

	msg_init(&resp, req.h.msg_id, MLINK_CTRL_RESP, req.h.txn_id, 0);
	switch (req.h.msg_id) {
	case MLINK_MSG_GET_LINK_INFO: {
		u32 state = m.state, peer_gen = m.peer_gen, mtu = OWN_MTU;

		tlv_put(&resp, MLINK_TLV_LINK_STATE, &state, 4);
		tlv_put(&resp, MLINK_TLV_PEER_GEN, &peer_gen, 4);
		tlv_put(&resp, MLINK_TLV_MTU, &mtu, 4);
		break;
	}
	case MLINK_MSG_GET_STATS: {
		u64 rx = m.st.rx, tx = m.st.tx;

		tlv_put(&resp, MLINK_TLV_RX_PKTS, &rx, 8);
		tlv_put(&resp, MLINK_TLV_TX_PKTS, &tx, 8);
		tlv_put(&resp, MLINK_TLV_RX_BYTES, &m.st.rx_bytes, 8);
		tlv_put(&resp, MLINK_TLV_TX_BYTES, &m.st.tx_bytes, 8);
		break;
	}
	case MLINK_MSG_SET_DATA_CALL: {
		const u8 *want = tlv_get(&req, len, MLINK_TLV_DATA_CALL, 1);
		struct msgbuf ind;
		u8 now;

		if (!want) {
			resp.h.result = -EINVAL;
			break;
		}
		WRITE_ONCE(m.data_call, *want != 0);
		modem_net_carrier(m.link_up && m.data_call);
		now = m.data_call;
		tlv_put(&resp, MLINK_TLV_DATA_CALL, &now, 1);
		sent = ctrl_send(&resp);
		/* Unsolicited: every AP client learns the new state (as mlinkd does). */
		msg_init(&ind, MLINK_MSG_IND_DATA_CALL, MLINK_CTRL_IND, 0, 0);
		tlv_put(&ind, MLINK_TLV_DATA_CALL, &now, 1);
		ctrl_send(&ind);
		printk("mlink-modem: data call -> %s\n", now ? "up" : "down");
		return sent;
	}
	default:
		resp.h.result = -EOPNOTSUPP;
	}
	return ctrl_send(&resp);
}

void modem_ctrl_poll(void)
{
	struct mlink_rx_desc d;
	bool consumed = false, published = false;
	int ret;

	while ((ret = mlink_ring_peek(&m.ctrl_rx, &d)) != 0) {
		if (ret == -EIO) {
			m.rx_broken = true;	/* the link tick resets */
			break;
		}
		if (ret > 0 && d.proto == MLINK_PROTO_CTRL && d.len >= sizeof(req.h)) {
			/* Copy first, then validate only our copy (no double fetch). */
			memcpy(req.raw, d.data, d.len);
			if (sizeof(req.h) + req.h.len == d.len && req.h.type == MLINK_CTRL_REQ) {
				m.st.ctrl_req++;
				if (serve(d.len)) {
					m.st.ctrl_resp++;
					published = true;
				}
			} else {
				m.st.ctrl_invalid++;
			}
		} else {
			m.st.ctrl_invalid++;
		}
		mlink_ring_consume(&m.ctrl_rx);
		consumed = true;
	}
	if (consumed)
		mlink_ring_release(&m.ctrl_rx);
	/* Low rate: always kick, so a writer waiting for space on the AP wakes up. */
	if (consumed || published)
		modem_kick(MLINK_VEC_CTRL);
}
```

## src/modem.h
```c
/* SPDX-License-Identifier: GPL-2.0-only */
/* State shared by the link/ring core (main.c) and the IP-stack glue (net.c). */
#ifndef MLINK_MODEM_H
#define MLINK_MODEM_H

#include <zephyr/kernel.h>

#include <asm/barrier.h>	/* compat/: virt_* as in Linux */
#include <linux/compiler.h>	/* compat/: READ_ONCE, WRITE_ONCE */

#include "mlink_ring.h"

#define OWN_MTU		1500

struct modem_stats {
	u32 irqs[MLINK_NR_VECTORS];
	u32 rx, tx, icmp, udp, frags, dropped, bad_len, tx_full;
	u32 to_stack, csum_fixed, tx_waits, tx_dropped;
	u32 kicks_data, kicks_space, kicks_state;
	u32 link_ups, link_resets;
	u64 rx_bytes, tx_bytes;			/* data rings, for GET_STATS */
	u32 ctrl_req, ctrl_resp, ctrl_invalid, ctrl_full, dc_dropped;
};

struct modem {
	const struct device *dev;
	u8 *shm;
	struct mlink_shm_hdr *hdr;
	struct mlink_shm_state *self, *peer;	/* MODEM block, AP block */
	struct mlink_ring tx, rx;		/* ring B (to AP), ring A (from AP) */
	struct mlink_ring ctrl_tx, ctrl_rx;	/* rings D, C: only reset, not served */

	/*
	 * Ring B producers: the poll thread (loopback) or Zephyr net/app threads
	 * via send() (IP stack). The lock keeps ring B single-producer and
	 * excludes the link reset, which zeroes the producer index.
	 */
	struct k_mutex tx_lock;
	struct k_sem space_sem;		/* given on every SPACE doorbell */

	u32 own_id, peer_id;
	bool hdr_ok, peer_found, link_up;
	bool data_call;		/* SET_DATA_CALL from the AP; down = drop data traffic */
	enum mlink_link_state state;
	u32 gen, peer_gen, tx_seq;
	bool rx_broken, tx_broken;

	u32 hb_seen, peer_activity;
	int64_t hb_changed;

	struct modem_stats st;
};

extern struct modem m;

void modem_kick(enum mlink_vector vec);

/* ctrl.c: serve control requests from ring C, answer on ring D (poll thread). */
void modem_ctrl_poll(void);

#ifdef CONFIG_MLINK_MODEM_NET
/* net.c: hand one validated packet (private copy) to the IP stack. */
bool modem_net_rx(u8 *data, u32 len, const struct mlink_rx_desc *d);
void modem_net_carrier(bool up);
#else
static inline bool modem_net_rx(u8 *data, u32 len, const struct mlink_rx_desc *d)
{
	return false;
}
static inline void modem_net_carrier(bool up) {}
#endif

#endif /* MLINK_MODEM_H */
```

## src/net.c
```c
// SPDX-License-Identifier: GPL-2.0-only
/*
 * IP-stack mode (P8.3, plan.md D20): the ring pair becomes a Zephyr network
 * interface. DUMMY_L2 means "no link-layer header", i.e. raw IP like Linux's
 * ARPHRD_RAWIP on the AP side (and mhi_net); the net core picks IPv4/IPv6 from
 * the version nibble. On top of it: UDP echo :7, TCP echo :7, TCP discard :9.
 */
#include <zephyr/net/dummy.h>
#include <zephyr/net/net_if.h>
#include <zephyr/net/net_ip.h>
#include <zephyr/net/net_pkt.h>
#include <zephyr/net/socket.h>
#include <zephyr/sys/byteorder.h>
#include <zephyr/sys/printk.h>

#include "modem.h"

#define MODEM_IPV4	"10.77.0.2"
#define MODEM_NETMASK	"255.255.255.0"
#define TX_WAIT_MS	100
#define TX_MAX_WAITS	20	/* then drop: TCP retransmits, UDP is lossy anyway */

static struct net_if *mlink_iface;

/* ---- RX: ring A -> stack (poll thread) ----------------------------------- */

/*
 * The AP sent CHECKSUM_PARTIAL (D17): the L4 checksum field holds only the
 * pseudo-header seed. Zephyr verifies L4 checksums, so finish the job the
 * way skb_checksum_help() does. start/offset come from shared memory: bound
 * them against this packet before use.
 */
static bool csum_complete(u8 *data, u32 len, const struct mlink_rx_desc *d)
{
	u32 start = d->csum_start, off = d->csum_offset, sum = 0, i;
	u16 csum;

	if (start >= len || off > len - start || len - start - off < 2)
		return false;
	for (i = start; i + 1 < len; i += 2)
		sum += sys_get_be16(&data[i]);
	if (i < len)
		sum += data[i] << 8;	/* odd length: pad with a zero byte */
	sum = (sum & 0xffff) + (sum >> 16);
	sum = (sum & 0xffff) + (sum >> 16);
	csum = ~sum;
	sys_put_be16(csum ? csum : 0xffff, &data[start + off]);
	return true;
}

bool modem_net_rx(u8 *data, u32 len, const struct mlink_rx_desc *d)
{
	struct net_pkt *pkt;

	if (!mlink_iface)
		return false;
	if (d->flags & MLINK_DESC_F_CSUM_PARTIAL) {
		if (!csum_complete(data, len, d))
			return false;
		m.st.csum_fixed++;
	}
	pkt = net_pkt_rx_alloc_with_buffer(mlink_iface, len, NET_AF_UNSPEC, 0, K_NO_WAIT);
	if (!pkt)
		return false;
	if (net_pkt_write(pkt, data, len) || net_recv_data(mlink_iface, pkt) < 0) {
		net_pkt_unref(pkt);
		return false;
	}
	return true;
}

void modem_net_carrier(bool up)
{
	if (!mlink_iface)
		return;
	if (up)
		net_if_carrier_on(mlink_iface);
	else
		net_if_carrier_off(mlink_iface);
}

/* ---- TX: stack -> ring B (any net/app thread) ---------------------------- */

static int mlink_net_send(const struct device *dev, struct net_pkt *pkt)
{
	struct mlink_tx_meta meta = {
		.proto = net_pkt_family(pkt) == NET_AF_INET6 ? MLINK_PROTO_IPV6 : MLINK_PROTO_IPV4,
	};
	size_t len = net_pkt_get_len(pkt);
	int ret = -ENETDOWN, waits = 0;

	ARG_UNUSED(dev);
	if (!len || len > MLINK_SLOT_SIZE)
		return -EMSGSIZE;

	k_mutex_lock(&m.tx_lock, K_FOREVER);
	for (;;) {
		int n;

		if (!READ_ONCE(m.link_up) || !READ_ONCE(m.data_call))
			break;
		n = mlink_ring_free(&m.tx);
		if (n < 0) {
			WRITE_ONCE(m.tx_broken, true);	/* the link tick resets */
			ret = -EIO;
			break;
		}
		if (n > 0) {
			net_pkt_cursor_init(pkt);
			ret = net_pkt_read(pkt, mlink_ring_slot(&m.tx), len);
			if (ret)
				break;
			mlink_ring_publish(&m.tx, len, &meta, m.tx_seq++);
			m.st.tx++;
			m.st.tx_bytes += len;
			if (mlink_ring_need_kick(&m.tx, true))
				modem_kick(MLINK_VEC_DATA);
			break;
		}
		/* Full: ask for a SPACE kick, then re-check (SB pattern). */
		if (mlink_ring_arm_space(&m.tx, true)) {
			mlink_ring_disarm_space(&m.tx);
			continue;
		}
		if (++waits > TX_MAX_WAITS) {
			ret = -ENOBUFS;
			break;
		}
		m.st.tx_waits++;
		/* Sleep unlocked: the link reset needs tx_lock. The timeout covers a lost kick. */
		k_mutex_unlock(&m.tx_lock);
		k_sem_take(&m.space_sem, K_MSEC(TX_WAIT_MS));
		k_mutex_lock(&m.tx_lock, K_FOREVER);
	}
	k_mutex_unlock(&m.tx_lock);
	if (ret)
		m.st.tx_dropped++;
	return ret;
}

/* ---- interface ----------------------------------------------------------- */

static void mlink_iface_init(struct net_if *iface)
{
	static const u8 lladdr[6] = { 0x02, 0x00, 0x00, 0x00, 0x00, 0x02 };
	struct net_in_addr addr, mask;

	net_if_set_link_addr(iface, (u8 *)lladdr, sizeof(lladdr), NET_LINK_DUMMY);
	net_addr_pton(NET_AF_INET, MODEM_IPV4, &addr);
	net_addr_pton(NET_AF_INET, MODEM_NETMASK, &mask);
	net_if_ipv4_addr_add(iface, &addr, NET_ADDR_MANUAL, 0);
	net_if_ipv4_set_netmask_by_addr(iface, &addr, &mask);
	/* No carrier until the mlink handshake says UP. */
	net_if_carrier_off(iface);
	mlink_iface = iface;
}

static int mlink_dev_init(const struct device *dev)
{
	ARG_UNUSED(dev);
	return 0;
}

static const struct dummy_api mlink_net_api = {
	.iface_api.init = mlink_iface_init,
	.send = mlink_net_send,
};

NET_DEVICE_INIT(mlink, "mlink0", mlink_dev_init, NULL, NULL, NULL,
		CONFIG_KERNEL_INIT_PRIORITY_DEFAULT, &mlink_net_api, DUMMY_L2,
		NET_L2_GET_CTX_TYPE(DUMMY_L2), OWN_MTU);

/* ---- services ------------------------------------------------------------ */

static int listen_on(int type, int proto, u16 port)
{
	struct net_sockaddr_in a = {
		.sin_family = NET_AF_INET,
		.sin_port = net_htons(port),
	};
	int s = zsock_socket(NET_AF_INET, type, proto);

	if (s < 0 || zsock_bind(s, (struct net_sockaddr *)&a, sizeof(a)) < 0 ||
	    (type == NET_SOCK_STREAM && zsock_listen(s, 1) < 0)) {
		printk("mlink-modem: port %u: socket setup failed (%d)\n", port, errno);
		return -1;
	}
	return s;
}

static void udp_echo(void *p1, void *p2, void *p3)
{
	static u8 buf[OWN_MTU];
	struct net_sockaddr_in from;
	net_socklen_t flen;
	int s = listen_on(NET_SOCK_DGRAM, NET_IPPROTO_UDP, 7);
	ssize_t n;

	while (s >= 0) {
		flen = sizeof(from);
		n = zsock_recvfrom(s, buf, sizeof(buf), 0, (struct net_sockaddr *)&from, &flen);
		if (n > 0)
			zsock_sendto(s, buf, n, 0, (struct net_sockaddr *)&from, flen);
	}
}

/* One client at a time: echo (port 7) or discard with a byte count (port 9). */
static void tcp_server(void *port_arg, void *p2, void *p3)
{
	static u8 bufs[2][2048];
	u16 port = (uintptr_t)port_arg;
	u8 *buf = bufs[port == 9];
	int s = listen_on(NET_SOCK_STREAM, NET_IPPROTO_TCP, port);

	while (s >= 0) {
		int c = zsock_accept(s, NULL, NULL);
		int64_t t0 = k_uptime_get();
		size_t total = 0;
		ssize_t n;

		if (c < 0)
			continue;
		while ((n = zsock_recv(c, buf, sizeof(buf), 0)) > 0) {
			total += n;
			for (ssize_t off = 0; port == 7 && off < n;) {
				ssize_t w = zsock_send(c, buf + off, n - off, 0);

				if (w <= 0) {
					n = -1;
					break;
				}
				off += w;
			}
			if (n < 0)
				break;
		}
		printk("mlink-modem: tcp :%u client done: %zu bytes in %lld ms\n", port, total,
		       k_uptime_get() - t0);
		zsock_close(c);
	}
}

K_THREAD_DEFINE(udp_echo_tid, 2048, udp_echo, NULL, NULL, NULL, 7, 0, 0);
K_THREAD_DEFINE(tcp_echo_tid, 3072, tcp_server, (void *)7, NULL, NULL, 7, 0, 0);
K_THREAD_DEFINE(tcp_discard_tid, 3072, tcp_server, (void *)9, NULL, NULL, 7, 0, 0);
```
